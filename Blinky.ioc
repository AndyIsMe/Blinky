# file: Blinky.ioc
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Mcu.Family=STM32F4
Mcu.Name=STM32F429Z(E-G-I)Tx
Mcu.Package=LQFP144
NVIC.PriorityGroup=NVIC_PRIORITYGROUP_4
PA13.Mode=Serial_Wire
PA13.Signal=SYS_JTMS-SWDIO
PA14.Mode=Serial_Wire
PA14.Signal=SYS_JTCK-SWCLK
PH0/OSC_IN.Mode=HSE-External-Oscillator
PH0/OSC_IN.Signal=RCC_OSC_IN
PH1/OSC_OUT.Mode=HSE-External-Oscillator
PH1/OSC_OUT.Signal=RCC_OSC_OUT
ProjectManager.HeapSize=0x200
ProjectManager.StackSize=0x400
ProjectManager.TargetToolchain=SW4STM32
RCC.48MHZClocksFreq_Value=90000000
RCC.AHBFreq_Value=180000000
RCC.APB1CLKDivider=RCC_HCLK_DIV4
RCC.APB1Freq_Value=45000000
RCC.APB1TimFreq_Value=90000000
RCC.APB2CLKDivider=RCC_HCLK_DIV4
RCC.APB2Freq_Value=45000000
RCC.APB2TimFreq_Value=90000000
RCC.CortexFreq_Value=180000000
RCC.HCLKFreq_Value=180000000
RCC.HSE_VALUE=8000000
RCC.HSI_VALUE=16000000
RCC.LSE_VALUE=32768
RCC.PLLM=8
RCC.PLLN=180
RCC.SYSCLKFreq_VALUE=180000000
RCC.SYSCLKSource=RCC_SYSCLKSOURCE_PLLCLK
RCC.VCOOutputFreq_Value=360000000
board=Blinky

// file: Src/main.c
/**
  ******************************************************************************
  * File Name          : main.c
  * Description        : Main program body
  ******************************************************************************
  ** This notice applies to any and all portions of this file
  * that are not between comment pairs USER CODE BEGIN and
  * USER CODE END. Other portions of this file, whether
  * inserted by the user or by software development tools
  * are owned by their respective copyright owners.
  *
  * COPYRIGHT(c) 2017 STMicroelectronics
  *
  * Redistribution and use in source and binary forms, with or without modification,
  * are permitted provided that the following conditions are met:
  *   1. Redistributions of source code must retain the above copyright notice,
  *      this list of conditions and the following disclaimer.
  *   2. Redistributions in binary form must reproduce the above copyright notice,
  *      this list of conditions and the following disclaimer in the documentation
  *      and/or other materials provided with the distribution.
  *   3. Neither the name of STMicroelectronics nor the names of its contributors
  *      may be used to endorse or promote products derived from this software
  *      without specific prior written permission.
  *
  * THIS SOFTWARE IS PROVIDED BY THE COPYRIGHT HOLDERS AND CONTRIBUTORS "AS IS"
  * AND ANY EXPRESS OR IMPLIED WARRANTIES, INCLUDING, BUT NOT LIMITED TO, THE
  * IMPLIED WARRANTIES OF MERCHANTABILITY AND FITNESS FOR A PARTICULAR PURPOSE ARE
  * DISCLAIMED. IN NO EVENT SHALL THE COPYRIGHT HOLDER OR CONTRIBUTORS BE LIABLE
  * FOR ANY DIRECT, INDIRECT, INCIDENTAL, SPECIAL, EXEMPLARY, OR CONSEQUENTIAL
  * DAMAGES (INCLUDING, BUT NOT LIMITED TO, PROCUREMENT OF SUBSTITUTE GOODS OR
  * SERVICES; LOSS OF USE, DATA, OR PROFITS; OR BUSINESS INTERRUPTION) HOWEVER
  * CAUSED AND ON ANY THEORY OF LIABILITY, WHETHER IN CONTRACT, STRICT LIABILITY,
  * OR TORT (INCLUDING NEGLIGENCE OR OTHERWISE) ARISING IN ANY WAY OUT OF THE USE
  * OF THIS SOFTWARE, EVEN IF ADVISED OF THE POSSIBILITY OF SUCH DAMAGE.
  *
  ******************************************************************************
  */
#include "main.h"
#include "stm32f4xx_hal.h"
#include <stdio.h>
#include <stdlib.h>
#include "DMA.h"
#include "Flash.h"
#include "GPIO.h"
#include "I2C.h"
#include "Rcc.h"
#include "Rng.h"
#include "Timer.h"
#include "USART.h"
#include "SysTick.h"
#include "SysCfg.h"
#include "Nvic.h"
#include "EXTI.h"
#include "ADC.h"
#include "IWDG.h"
#include <stm32f4xx.h>
#include <string.h>

/* USER CODE BEGIN Includes */
#define redLedPin		14
#define greenLedPin		13
#define blueButtonPin 	0
#define	ARR_ONE_PERIOD 125
#define ARR_Low_Period0 12
#define ARR_Low_Period1 114
uint16_t timeWaveform[] = {ARR_Low_Period0,ARR_ONE_PERIOD,ARR_Low_Period1,ARR_ONE_PERIOD,ARR_ONE_PERIOD+2};
/* USER CODE END Includes */

/* USER CODE BEGIN PV */
/* Private variables ---------------------------------------------------------*/

/* USER CODE END PV */

void SystemClock_Config(void);
static void MX_GPIO_Init(void);
extern void initialise_monitor_handles(void);
void PrintCauseOfReset(void);
void wwdgWaitFor500msec(void);
/* USER CODE BEGIN PFP */
/* Private function prototypes -----------------------------------------------*/

/* USER CODE END PFP */

int main(void)
{

  /* USER CODE BEGIN 1 */
	volatile int i=0;
	initialise_monitor_handles();
  /* USER CODE END 1 */

  /* MCU Configuration----------------------------------------------------------*/

  /* Reset of all peripherals, Initializes the Flash interface and the Systick. */
  HAL_Init();

  /* Configure the system clock */
  SystemClock_Config();

  /* Initialize all configured peripherals */
  MX_GPIO_Init();

  /* USER CODE BEGIN 2 */
  /*enableRng();
  printf("Hello , world!\n");
  enableGpioA();
  enableGpioG();
  gpioConfig(GpioA,blueButtonPin , GPIO_MODE_IN , 0 , GPIO_NO_PULL,0);
  gpioConfig(GpioG,redLedPin , GPIO_MODE_OUT , GPIO_PUSH_PULL,GPIO_NO_PULL,GPIO_HI_SPEED);
  gpioConfig(GpioG,greenLedPin , GPIO_MODE_OUT , GPIO_PUSH_PULL,GPIO_NO_PULL,GPIO_LOW_SPEED);*/

  //Configure GPIOA pin 8 as MCO1 (push-pull with no-pull at very
  //high speed output)
 // gpioConfig(GpioA,8,GPIO_MODE_AF,GPIO_PUSH_PULL,GPIO_NO_PULL,GPIO_VHI_SPEED);
 // gpioConfigAltFuncNum(GpioA,8,ALT_FUNC0);
  //rccSelectMco1src(MCO_PLL_SRC);
  //rccSetMco1PreScaler(MCO_DIV_BY_4);

  //sysTickDisable();
  //Enable External Interrupt 0 (EXTI0) and set the interrupt priority to 9
 // nivcEnableIrq(6);
  //nvicSetPriority( 6, 4);
  //Enable GPIOA pin 0 (connected to user blue button)
  //ExtiCLRIT(blueButtonPin);
  //ExtiSetET(blueButtonPin);
  //Set External interrupt to falling edge while disable rising edge
  //ExtiResetRise(blueButtonPin);
  //ExtiSetFall(blueButtonPin);
  //ExtiSoftwareTrigger(blueButtonPin);
  //ExtiReadPendingInterrupt(blueButtonPin);
  /* USER CODE END 2 */

  /* Infinite loop */
  /* USER CODE BEGIN WHILE */
  //enableGpioG();
   //gpioConfig(GpioG,redLedPin , GPIO_MODE_OUT , GPIO_PUSH_PULL,GPIO_NO_PULL,GPIO_HI_SPEED);
   volatile uint32_t flag;
   //initTimer8();
   //void initTimer8Channel1();
   //haltTimerWhenDebugging();
   //initTimer8wait500ms();
   //enableGpioB();
   //testI2C();

   //Flash
   //flashEraseSection(13);
   //flashEnableProgramming(FLASH_BYTE_SIZE);
   /*flashEnableProgramming(FLASH_BYTE_SIZE);
   writeMessage("Hello World!",(char *)0x08060000);
   if (flashEraseSection(7) == 1){
   flashEnableProgramming(FLASH_BYTE_SIZE);
   //*((char*)0x08100000) = 'h';
   writeMessage("Hello World!",(char *)0x08100000);
   *((char*)0x08084000 + 10) = 'h';
   flashDisable();
   		  while(1);
 		  }
 		  else{
 			  while(1);
 		  }*/
 		  //enableDMA(DMA1_DEV);
 		  //enableDMA(DMA2_DEV);
 		  //DmainitForUsart1("\nHello World!\n");
   	   	  //enableADC();
   	   	  //gpioConfig(GpioA,5, GPIO_MODE_ANA , GPIO_PUSH_PULL , GPIO_NO_PULL , GPIO_VHI_SPEED);
   	   	  //gpioConfig(GpioC,3, GPIO_MODE_ANA , GPIO_PUSH_PULL , GPIO_NO_PULL , GPIO_VHI_SPEED);
   	   	  //SingleConvConfig(5);
   	   	  DoubleConvConfig(5,3);
   	   	  /*enableTimer8();
   	   	  enableDMAforTimer8();
   	   	  _initTimer8Channel1();
   	   	  forceOutCompareChannel1High();
   	   	  enableDMA(DMA2_DEV);
   	   	  DmainitForTimer8();
   	   	  DmasetAddressesAndSize((char *)timeWaveform,&(Timer8->CCR1),strlen(timeWaveform));*/
   	   	  /*
   	   	  while(1){
	   		  int ana = adc1->DR;
	   		float voltage = ((3.3*ana)/4096);

   	   	printf("%f\n",voltage);
   	   	  }*/
   	   	  //IWDGConfig();
 		  /*enableGpioA();
 		  enableGpioG();
 		  gpioConfig(GpioA,9,GPIO_MODE_AF,GPIO_PUSH_PULL,GPIO_PULL_UP,GPIO_VHI_SPEED);
 		  gpioConfigAltFuncNum(GpioA,9,ALT_FUNC7);
 		  gpioConfig(GpioA,10,GPIO_MODE_AF,GPIO_PUSH_PULL,GPIO_PULL_UP,GPIO_VHI_SPEED);
 		  gpioConfigAltFuncNum(GpioA,10,ALT_FUNC7);
 		  gpioConfig(GpioG,redLedPin, GPIO_MODE_OUT, GPIO_PUSH_PULL, GPIO_NO_PULL, GPIO_HI_SPEED);
 		  gpioConfig(GpioG,greenLedPin, GPIO_MODE_OUT, GPIO_PUSH_PULL, GPIO_NO_PULL, GPIO_HI_SPEED);
 		  gpioConfig(GpioA,8, GPIO_MODE_AF, GPIO_PUSH_PULL, GPIO_NO_PULL,GPIO_HI_SPEED );
 		  gpioConfigAltFuncNum(GpioA,8,ALT_FUNC8);
 		  enableUSART1();*/
 		  //uart1EnableDmaTx();
 		  /*USARTConfig();
 		  BaudRateSetting(0x30,0xd);
 		  USARTTransmit();
 		  USARTConfigReceive();*/

 		  //char *data = (char *)malloc(sizeof(char)*256);
 		  //int num;
 		 //serialPrint("%s","Hello world!");

   	   	  enableGpioG();
   	   	  gpioConfig(GpioG,redLedPin, GPIO_MODE_OUT, GPIO_PUSH_PULL, GPIO_NO_PULL, GPIO_HI_SPEED);
   	   	  PrintCauseOfReset();
   	   	  Rcc->CSR |= RCC_RMVF;
   	   	  enableWWDG();

   	   	  //HAL_Delay(1000);
   	   	  /*StartIWDG();
   	   	  IWDGConfig();
   	   	  TicksInput(FOUR_SEC_IN_Div_64);
   		  while(iwdgPVUIsEmpty()==1);
   		  IWDGPreScale();
   		  while(iwdgRVUIsEmpty()==1);
   		  IWDGReset();*/

   		  /*while(i++<20){
   			  gpioWrite(GpioG,redLedPin,1);
   			  HAL_Delay(50);
   			  gpioWrite(GpioG,redLedPin,0);
   			  HAL_Delay(50);

   		  }*/

  while (1)
  {
			wwdgWaitFor500msec();
			gpioWrite(GpioG,redLedPin,1);
			wwdgWaitFor500msec();
			gpioWrite(GpioG,redLedPin,0);
	  	  //HAL_Delay(7);
  	      //WWDGConfig(63);
	  	//WWDGConfig(63);
	  // Just waiting for core reset to happen
	  //IWDGReset();

	  //toggleOutCompareChannel1();
	  //toggleOutCompareChannel1WithForce();

  /* USER CODE END WHILE */

  /* USER CODE BEGIN 3 */
	  //usartReceiveTillRespond(&data);
/*
	  if(strcmp(&data," Turn ON") == 0)
		  num = 1;
	  else if(strcmp(&data," Turn OFF") == 0)
		  num = 2;

	  switch(num){
	  case 1:
		  gpioWrite(GpioG,redLedPin,1);
	  	  break;
	  case 2:
	  	 gpioWrite(GpioG,redLedPin,0);
	  	  break;
	  default:
		  gpioWrite(GpioG,redLedPin,0);

	  }*/

	  //writeData("Hello world!");
	  //writeData("\n");
	  //HAL_DELAY(1000);

	 // usart1Receive(data);

	  /*
	  gpioWrite(GpioG,redLedPin,1);
	  Wait_For_OV();
	  gpioWrite(GpioG,redLedPin,0);
	  Wait_For_OV();
		*/
	  //gpioWrite(GpioG,redLedPin,1);
	  //__WFE();
	  //__WFE();
	  //__WFI();
	  //gpioWrite(GpioG,redLedPin,0);
  }
  /* USER CODE END 3 */

}

/** System Clock Configuration
*/
void SystemClock_Config(void)
{

  RCC_OscInitTypeDef RCC_OscInitStruct;
  RCC_ClkInitTypeDef RCC_ClkInitStruct;

    /**Configure the main internal regulator output voltage
    */
  __HAL_RCC_PWR_CLK_ENABLE();

  __HAL_PWR_VOLTAGESCALING_CONFIG(PWR_REGULATOR_VOLTAGE_SCALE1);

    /**Initializes the CPU, AHB and APB busses clocks
    */
  RCC_OscInitStruct.OscillatorType = RCC_OSCILLATORTYPE_HSI;
  RCC_OscInitStruct.HSIState = RCC_HSI_ON;
  RCC_OscInitStruct.HSICalibrationValue = 16;
  RCC_OscInitStruct.PLL.PLLState = RCC_PLL_ON;
  RCC_OscInitStruct.PLL.PLLSource = RCC_PLLSOURCE_HSI;
  RCC_OscInitStruct.PLL.PLLM = 8;
  RCC_OscInitStruct.PLL.PLLN = 180;
  RCC_OscInitStruct.PLL.PLLP = RCC_PLLP_DIV2;
  RCC_OscInitStruct.PLL.PLLQ = 4;
  if (HAL_RCC_OscConfig(&RCC_OscInitStruct) != HAL_OK)
  {
    _Error_Handler(__FILE__, __LINE__);
  }

    /**Activate the Over-Drive mode
    */
  if (HAL_PWREx_EnableOverDrive() != HAL_OK)
  {
    _Error_Handler(__FILE__, __LINE__);
  }

    /**Initializes the CPU, AHB and APB busses clocks
    */
  RCC_ClkInitStruct.ClockType = RCC_CLOCKTYPE_HCLK|RCC_CLOCKTYPE_SYSCLK
                              |RCC_CLOCKTYPE_PCLK1|RCC_CLOCKTYPE_PCLK2;
  RCC_ClkInitStruct.SYSCLKSource = RCC_SYSCLKSOURCE_PLLCLK;
  RCC_ClkInitStruct.AHBCLKDivider = RCC_SYSCLK_DIV1;
  RCC_ClkInitStruct.APB1CLKDivider = RCC_HCLK_DIV4;
  RCC_ClkInitStruct.APB2CLKDivider = RCC_HCLK_DIV4;

  if (HAL_RCC_ClockConfig(&RCC_ClkInitStruct, FLASH_LATENCY_5) != HAL_OK)
  {
    _Error_Handler(__FILE__, __LINE__);
  }

    /**Configure the Systick interrupt time
    */
  HAL_SYSTICK_Config(HAL_RCC_GetHCLKFreq()/1000);

    /**Configure the Systick
    */
  HAL_SYSTICK_CLKSourceConfig(SYSTICK_CLKSOURCE_HCLK);

  /* SysTick_IRQn interrupt configuration */
  HAL_NVIC_SetPriority(SysTick_IRQn, 0, 0);
}

/** Configure pins as
        * Analog
        * Input
        * Output
        * EVENT_OUT
        * EXTI
*/
static void MX_GPIO_Init(void)
{

  /* GPIO Ports Clock Enable */
  __HAL_RCC_GPIOH_CLK_ENABLE();
  __HAL_RCC_GPIOA_CLK_ENABLE();

}

/* USER CODE BEGIN 4 */
void EXTI0_IRQHandler(void){
	static volatile int count = 0;

	ExtiClrPendingInterrupt(blueButtonPin);
	count ++;

}
void Wait_For_OV(void){
	while(((Timer8->SR)&0x01)!=1){
	}
	Timer8->SR &= ~(0x01);
}
void My_SysTick_Handler(void){
	static int ledState = 0;
	//Read the CTRL register to clear the COUNTFLAG
	volatile int flag = Tick->CTRL;

	gpioWrite(GpioG,redLedPin,(ledState = !ledState));
}

void HASH_RNG_IRQHandler(void){
	volatile int rand = Rng->DR;
}

void PrintCauseOfReset(void)
{
	printf("Cause of Reset\n");
	if(Rcc->CSR & RCC_LPWRRSTF)
		printf("Low Power Reset\n");
	if(Rcc->CSR & RCC_WWDGRSTF)
		printf("Window Watchdog Reset\n");
	if(Rcc->CSR & RCC_IWDGRSTF)
		printf("Independent Watchdog Reset\n");
	if(Rcc->CSR & RCC_SFTRSTF)
		printf("Software Reset\n");
	if(Rcc->CSR & RCC_PORRSTF)
		printf("Power On Reset\n");
	if(Rcc->CSR & RCC_PINRSTF)
		printf("Nsrt PIN Reset\n");
	if(Rcc->CSR & RCC_BORRSTF)
		printf("Brownout Reset\n");

}

void wwdgWaitFor500msec(){
	int i = 0;
	wwdgSetWindowValue(55);
	WWDGConfig(55);
	ClearwwdgInterrupt();
	while(i++ <50){
		while(!(wwdg->SR & EWIF));
			WWDGConfig(55);
			ClearwwdgInterrupt();

	}

}
/* USER CODE END 4 */

void _Error_Handler(char * file, int line)
{
  while(1)
  {
  }
}

/************************ (C) COPYRIGHT STMicroelectronics *****END OF FILE****/
